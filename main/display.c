#include "display.h"
#include "driver/i2c.h"
#include <string.h>

#define I2C_MASTER_TX_BUF_DISABLE   0
#define I2C_MASTER_RX_BUF_DISABLE   0

// Tabella Font 5x8 ridotta (ASCII 32-126). 
// Ogni byte rappresenta una colonna verticale di 8 pixel.
static const uint8_t font5x8[][5] = {
    {0x00, 0x00, 0x00, 0x00, 0x00}, {0x00, 0x00, 0x5f, 0x00, 0x00}, // space, !
    {0x00, 0x07, 0x00, 0x07, 0x00}, {0x14, 0x7f, 0x14, 0x7f, 0x14}, // ", #
    {0x24, 0x2a, 0x7f, 0x2a, 0x12}, {0x23, 0x13, 0x08, 0x64, 0x62}, // $, %
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    {0x00, 0x41, 0x36, 0x08, 0x00}, {0x02, 0x01, 0x02, 0x04, 0x02}  // }, ~
};

// --- Funzioni di utilità I2C interne ---
static esp_err_t ssd1306_send_cmd(uint8_t cmd) {
    i2c_cmd_handle_t handle = i2c_cmd_link_create();
    i2c_master_start(handle);
    i2c_master_write_byte(handle, (SSD1306_I2C_ADDR << 1) | I2C_MASTER_WRITE, true);
    i2c_master_write_byte(handle, 0x00, true); // Co = 0, D/C = 0 (Comando)
    i2c_master_write_byte(handle, cmd, true);
    i2c_master_stop(handle);
    esp_err_t err = i2c_master_cmd_begin(I2C_MASTER_NUM, handle, pdMS_TO_TICKS(1000));
    i2c_cmd_link_delete(handle);
    return err;
}

static esp_err_t ssd1306_send_data(const uint8_t *data, size_t length) {
    i2c_cmd_handle_t handle = i2c_cmd_link_create();
    i2c_master_start(handle);
    i2c_master_write_byte(handle, (SSD1306_I2C_ADDR << 1) | I2C_MASTER_WRITE, true);
    i2c_master_write_byte(handle, 0x40, true); // Co = 0, D/C = 1 (Dati)
    i2c_master_write(handle, data, length, true);
    i2c_master_stop(handle);
    esp_err_t err = i2c_master_cmd_begin(I2C_MASTER_NUM, handle, pdMS_TO_TICKS(1000));
    i2c_cmd_link_delete(handle);
    return err;
}

static void ssd1306_set_cursor(uint8_t page, uint8_t col) {
    ssd1306_send_cmd(0xB0 + page);                      // Set Page Start Address
    ssd1306_send_cmd(0x00 | (col & 0x0F));              // Set Lower Column Address
    ssd1306_send_cmd(0x10 | ((col >> 4) & 0x0F));       // Set Higher Column Address
}

// --- API Pubbliche ---
esp_err_t display_init(void) {
    // 1. Inizializzazione I2C (Master)
    i2c_config_t conf = {
        .mode = I2C_MODE_MASTER,
        .sda_io_num = I2C_MASTER_SDA_IO,
        .scl_io_num = I2C_MASTER_SCL_IO,
        .sda_pullup_en = GPIO_PULLUP_ENABLE,
        .scl_pullup_en = GPIO_PULLUP_ENABLE,
        .master.clk_speed = I2C_MASTER_FREQ_HZ,
    };
    esp_err_t err = i2c_param_config(I2C_MASTER_NUM, &conf);
    if (err != ESP_OK) return err;
    err = i2c_driver_install(I2C_MASTER_NUM, conf.mode, I2C_MASTER_RX_BUF_DISABLE, I2C_MASTER_TX_BUF_DISABLE, 0);
    if (err != ESP_OK) return err;

    // 2. Sequenza di Boot SSD1306 (128x64)
    uint8_t init_cmds[] = {
        0xAE,           // Display OFF
        0x20, 0x02,     // Set Memory Addressing Mode a Page Addressing (default)
        0x81, 0xFF,     // Set Contrast Control (max)
        0xA1,           // Set Segment Re-map (gira asse X)
        0xC8,           // Set COM Output Scan Direction (gira asse Y)
        0xA6,           // Normal Display (non invertito)
        0xA8, 0x3F,     // Set Multiplex Ratio (1/64)
        0xD3, 0x00,     // Set Display Offset (0)
        0x40,           // Set Start Line (0)
        0x8D, 0x14,     // Enable Charge Pump (necessario per accendere i LED)
        0xAF            // Display ON
    };

    for (int i = 0; i < sizeof(init_cmds); i++) {
        err = ssd1306_send_cmd(init_cmds[i]);
        if (err != ESP_OK) return err;
    }
    return ESP_OK;
}

void display_clear(void) {
    uint8_t empty_line[128];
    memset(empty_line, 0x00, sizeof(empty_line)); // Buffer di zeri
    
    for (uint8_t page = 0; page < 8; page++) {
        ssd1306_set_cursor(page, 0);
        ssd1306_send_data(empty_line, 128);
    }
}

void display_draw_text(uint8_t page, uint8_t col, const char *text, const char *text_end) {
    ssd1306_set_cursor(page, col);
    while (*text) {
        if (text_end && text >= text_end) {
            break;
        }
        char c = *text;
        // Salta caratteri fuori dal nostro mini-font
        if (c >= 32 && c <= 126) {
            uint8_t index = c - 32;
            ssd1306_send_data(font5x8[index], 5);
            
            // Spaziatura tra i caratteri (1 colonna vuota)
            uint8_t spacer = 0x00;
            ssd1306_send_data(&spacer, 1);
        }
        text++;
    }
}
