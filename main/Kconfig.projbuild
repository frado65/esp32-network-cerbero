## main/Kconfig.projbuild
```kconfig
menu "Template Configuration"

    config WIFI_SSID
        string "WiFi SSID"
        default "Wind3 HUB - DDAF85_guest1"
        help
            SSID of the WiFi network to connect to.

    config WIFI_PASSWORD
        string "WiFi Password"
        default "xxxxxxxxxxxxxxxxx"
        help
            Password of the WiFi network to connect to.

    config BLINK_GPIO_PIN
        int "Blink GPIO Pin"
        default 2
        help
            GPIO pin number to blink (typically GPIO 2 for onboard LED on many ESP32 dev boards).

endmenu
```

## sdkconfig.defaults
```kconfig
# CPU Frequency configuration (240MHz)
CONFIG_ESP_DEFAULT_CPU_FREQ_MHZ_240=y
CONFIG_ESP_DEFAULT_CPU_FREQ_MHZ=240
CONFIG_ESP32_DEFAULT_CPU_FREQ_240=y

# Log Level Configuration (INFO)
CONFIG_LOG_DEFAULT_LEVEL_INFO=y
CONFIG_LOG_DEFAULT_LEVEL=3

# Compiler Optimization (Optimize for size)
CONFIG_COMPILER_OPTIMIZATION_SIZE=y
```
